## main/Kconfig.projbuild
```kconfig
menu "DCT3 emulator"

    config DCT3_FW_LABEL
        string "Firmware partition label"
        default "fw"
        help
            Data partition that holds the Nokia .fls image (flashed raw).

    config DCT3_I2C_PORT
        int "SSD1306 I2C port"
        range 0 1
        default 0

    config DCT3_I2C_SDA
        int "SSD1306 SDA GPIO"
        default 8

    config DCT3_I2C_SCL
        int "SSD1306 SCL GPIO"
        default 9

    config DCT3_I2C_ADDR
        hex "SSD1306 I2C address"
        default 0x3C

    config DCT3_I2C_HZ
        int "SSD1306 I2C clock (Hz)"
        range 100000 1000000
        default 400000

    choice DCT3_KBD_BACKEND
        prompt "Keyboard input"
        default DCT3_KBD_BACKEND_USB_SERIAL_JTAG
        help
            Where typed characters are read from. USB Serial/JTAG works with
            the native USB port used for flashing and logging; UART needs a
            separate serial adapter.

        config DCT3_KBD_BACKEND_USB_SERIAL_JTAG
            bool "USB Serial/JTAG"

        config DCT3_KBD_BACKEND_UART
            bool "UART"
    endchoice

    config DCT3_KBD_UART
        int "Keyboard UART port"
        range 0 2
        default 0
        depends on DCT3_KBD_BACKEND_UART
        help
            UART used for the terminal keyboard. Port 0 is the usual console
            UART (GPIO43/44 on ESP32-S3).

    config DCT3_KBD_BAUD
        int "Keyboard UART baud rate"
        default 115200
        depends on DCT3_KBD_BACKEND_UART

    config DCT3_KBD_UART_TX
        int "Keyboard UART TX GPIO (-1 = keep console default)"
        default -1
        depends on DCT3_KBD_BACKEND_UART

    config DCT3_KBD_UART_RX
        int "Keyboard UART RX GPIO (-1 = keep console default)"
        default -1
        depends on DCT3_KBD_BACKEND_UART

    config DCT3_FRAME_MS
        int "Display frame period (ms)"
        range 10 100
        default 30

    config DCT3_SPEAKER_GPIO
        int "PC Speaker PWM GPIO (-1 = disabled)"
        range -1 48
        default 5
        help
            Passive PC Speaker or buzzer, driven by LEDC PWM at the frequency
            commanded by the emulated phone. Connect magnetic speakers via
            a transistor driver with common ground. Use a free output pin.

    config DCT3_EMU_HZ
        int "Emulated ARM clock (Hz)"
        default 13000000
        help
            The MAD2 ARM7 runs at 13 MHz. Pacing uses this to convert wall
            time into emulated cycles.

    config DCT3_PROFILE
        bool "Profile emulator stages"
        default n
        help
            Measure host cycles spent in each emulator stage. Leave disabled
            for normal use to remove profiling overhead from the hot loop.

    config DCT3_CODE_CACHE
        bool "Experimental SRAM instruction cache"
        default n
        help
            Uses 16 KiB of internal RAM. Disabled by default: the native
            PSRAM data cache was faster on the tested ESP32-S3 board.

endmenu
```
